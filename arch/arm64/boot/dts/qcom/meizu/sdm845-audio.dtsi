/*
 * Copyright (C) 2023 transaero21 <transaero21@elseboot.ru>
 *
 * SPDX-License-Identifier: GPL-2.0
 */

&dai_mi2s3 {
	qcom,msm-mi2s-rx-lines = <4>;
	qcom,msm-mi2s-tx-lines = <3>;
	qcom,msm-mi2s-rx-lines-b2 = <1>;
	qcom,msm-mi2s-tx-lines-b2 = <2>;
};
