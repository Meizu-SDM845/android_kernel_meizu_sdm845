/dts-v1/;
/plugin/;

#include "meizu-sdm845-overlay.dtsi"
#include "meizu-m1882-overlay-display.dtsi"

/{
    qcom,battery-data {
        #include "batterydata-meizu-m1882gy-3010mah.dtsi"
        #include "batterydata-meizu-m1882atl-3010mah.dtsi"
    };
};
