&mdss_mdp {
	s6e3fa6_amoled_fhd_cmd: qcom,mdss_dsi_s6e3fa6_amoled_fhd_cmd {
		qcom,mdss-dsi-panel-name = "s6e3fa6 amoled fhd cmd mode dsi panel";
		qcom,mdss-dsi-panel-type = "dsi_cmd_mode";
		qcom,mdss-dsi-virtual-channel-id = <0>;
		qcom,mdss-dsi-stream = <0>;
		qcom,mdss-dsi-bpp = <24>;
		qcom,mdss-dsi-underflow-color = <255>;
		qcom,mdss-dsi-border-color = <0>;
		qcom,mdss-dsi-color-order = "rgb_swap_rgb";
		qcom,mdss-dsi-panel-orientation = "180";
		qcom,mdss-dsi-traffic-mode = "non_burst_sync_pulse";
		qcom,mdss-dsi-bllp-eof-power-mode;
		qcom,mdss-dsi-bllp-power-mode;
		qcom,mdss-dsi-lane-0-state;
		qcom,mdss-dsi-lane-1-state;
		qcom,mdss-dsi-lane-2-state;
		qcom,mdss-dsi-lane-3-state;
		qcom,mdss-dsi-wr-mem-start = <44>;
		qcom,mdss-dsi-wr-mem-continue = <60>;
		qcom,mdss-dsi-te-pin-select = <1>;
		qcom,mdss-dsi-te-dcs-command = <1>;
		qcom,mdss-dsi-te-check-enable;
		qcom,mdss-dsi-te-using-te-pin;
		qcom,mdss-dsi-dma-trigger = "trigger_sw";
		qcom,mdss-dsi-mdp-trigger = "none";
		qcom,mdss-dsi-lp11-init;
		qcom,mdss-dsi-bl-pmic-control-type = "bl_ctrl_dcs";
		qcom,mdss-dsi-bl-min-level = <1>;
		qcom,mdss-dsi-bl-max-level = <255>;
		qcom,mdss-pan-physical-width-dimension = <70>;
		qcom,mdss-pan-physical-height-dimension = <125>;
		qcom,mdss-dsi-reset-sequence = <0 10 1 10>;
		qcom,mdss-dsi-t-clk-post = <14>;
		qcom,mdss-dsi-t-clk-pre = <49>;
		qcom,panel-supply-entries = <4>;
		qcom,mdss-dsi-mode-sel-gpio-state = "single_port";
		qcom,platform-reset-gpio = <&tlmm 6 0>;
		qcom,platform-te-gpio = <&tlmm 10 0>;

		qcom,mdss-dsi-display-timings {
			timing@0 {
				qcom,mdss-dsi-panel-framerate = <60>;
				qcom,mdss-dsi-panel-width = <1080>;
				qcom,mdss-dsi-panel-height = <1920>;
				qcom,mdss-dsi-h-front-porch = <128>;
				qcom,mdss-dsi-h-back-porch = <56>;
				qcom,mdss-dsi-h-pulse-width = <36>;
				qcom,mdss-dsi-h-sync-skew = <0>;
				qcom,mdss-dsi-v-back-porch = <11>;
				qcom,mdss-dsi-v-front-porch = <1>;
				qcom,mdss-dsi-v-pulse-width = <4>;
				qcom,mdss-dsi-h-left-border = <0>;
				qcom,mdss-dsi-h-right-border = <0>;
				qcom,mdss-dsi-v-top-border = <0>;
				qcom,mdss-dsi-v-bottom-border = <0>;
				qcom,mdss-dsi-on-command = [
					05 01 00 00 15 00 02 11 00 15 01 00
					00 00 00 02 35 00 39 01 00 00 00 00
					03 F0 5A 5A 15 01 00 00 00 00 02 B0
					07 15 01 00 00 00 00 02 B1 07 39 01
					00 00 00 00 03 F0 A5 A5 15 01 00 00
					00 00 02 53 28 15 01 00 00 00 00 02
					55 00 39 01 00 00 00 00 03 F0 5A 5A
					15 01 00 00 00 00 02 C3 13 15 01 00
					00 00 00 02 B0 0E 39 01 00 00 00 00
					40 C3 A7 0C 04 32 C8 14 08 06 AE 3E
					E7 CE C9 10 C0 E4 E4 18 FF FF FF F8
					0F 06 00 C8 00 06 05 BF 00 D2 B9 FF
					14 C5 E3 E7 0D FF FF FF BE 03 00 05
					BE 03 09 06 BB 0B EA CF EE 07 CE E1
					E1 01 FF FF FF 39 01 00 00 65 00 03
					F0 A5 A5 05 01 00 00 00 00 02 29 00
				];
				qcom,mdss-dsi-off-command = [
					05 01 00 00 10 00 02 28 00
					05 01 00 00 90 00 02 10 00
				];
				qcom,mdss-dsi-on-command-state = "dsi_hs_mode";
				qcom,mdss-dsi-off-command-state = "dsi_hs_mode";
				qcom,mdss-dsi-h-sync-pulse = <0>;
				qcom,mdss-dsi-panel-phy-timings = [00 20 08 08 24 23 08 08 05 03 04 00];
				qcom,display-topology = <1 0 1 2 0 1>;
				qcom,default-topology-index = <0>;
			};
		};
	};
};
