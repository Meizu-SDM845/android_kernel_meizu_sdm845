/*
 * Copyright (C) 2023 transaero21 <transaero21@elseboot.ru>
 *
 * SPDX-License-Identifier: GPL-2.0
 */

qcom,meizu_m1882atl_3010mah {
	/* 3511331_meizu_m1882atl_3010mah_averaged_masterslave_jun4th2018 */
	qcom, = <0x18>;
	qcom,max-voltage-uv = <4400000>;
	qcom,fastchg-current-ma = <2950>;
	qcom,nom-batt-capacity-mah = <3010>;
	qcom,batt-id-kohm = <50>;
	qcom,battery-beta = <3435>;
	qcom,fg-cc-cv-threshold-mv = <4390>;
	qcom,battery-name = "ATL";
	qcom,battery-type = "meizu_m1882atl_3010mah";
	qcom,checksum = <54421>;
	qcom,gui-version = "PMI8998GUI - 2.0.0.58";
	qcom,fg-profile-data = [
		BC 22 1B 0D
		6E 12 27 04
		FD 1C 77 01
		7F 05 04 03
		FC 17 6E 23
		07 45 85 53
		98 00 00 00
		12 00 00 00
		00 00 5D C5
		82 CD 19 C3
		2B 00 08 00
		13 EB E5 F5
		B9 FD 3B F2
		20 05 A6 0A
		93 EC 51 32
		1C 06 09 20
		27 00 14 00
		38 20 EB 04
		13 0B A8 05
		CE 1C D9 02
		35 0C 11 12
		91 18 D0 23
		E9 4D 2B 5B
		6E 00 00 00
		0E 00 00 00
		00 00 E9 D5
		06 C2 03 CA
		21 00 00 00
		AE F2 E5 F5
		3D F5 EC E3
		C1 EC E8 01
		13 F4 9F 1A
		9B 33 CC FF
		07 10 00 00
		C9 0B 66 46
		21 00 40 00
		56 01 0A FA
		FF 00 00 00
		00 00 00 00
		00 00 00 00
		00 00 00 00
		00 00 00 00
		00 00 00 00
		00 00 00 00
		00 00 00 00
		00 00 00 00
		00 00 00 00
		00 00 00 00
		00 00 00 00
		00 00 00 00
		00 00 00 00
		00 00 00 00
		00 00 00 00
		00 00 00 00
		00 00 00 00
		00 00 00 00
	];
};
