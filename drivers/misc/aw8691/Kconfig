## drivers/misc/aw8691/Kconfig
```kconfig
config AW8691_HAPTIC
	tristate "AW8691 Haptic Driver"
	default n
	help
	  Say Y here to enable awinic aw8691 haptic driver.

	  To compile this driver as a module, choose M here. The module
	  will be called aw8691.
```
